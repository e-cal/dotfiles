#define VERSION_MACRO
macro_ver: macro_ver {
compatible = "zmk,behavior-macro";
label = "macro_ver";
#binding-cells = <0>;
bindings = <&kp N2>, <&kp N0>, <&kp N2>, <&kp N5>, <&kp N1>, <&kp N2>, <&kp N0>, <&kp N8>, <&kp MINUS>, <&kp M>, <&kp A>, <&kp I>, <&kp N>, <&kp MINUS>, <&kp A>, <&kp N9>, <&kp E>, <&kp C>, <&kp N5>, <&kp N3>, <&kp N0>, <&kp RET>;
};
